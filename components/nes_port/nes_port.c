/*
 * MiniMario - nofrendo NES core port / OSD layer for the ESP32-C6.
 *
 * This file implements the frozen API from include/nes_port.h on top of the
 * nofrendo core in components/nofrendo.  It replaces the old IDF v3
 * components/nofrendo-esp32 OSD (raw SPI register poking, dual core video
 * queue, DAC audio) with:
 *
 *   - a static 256x240 palette index framebuffer that the nofrendo PPU renders
 *     into directly (no extra 57KB blit buffer, no heap allocation),
 *   - a 256 entry RGB565 palette converted in the video driver set_palette hook,
 *   - an own frame loop paced by esp_timer at 60.0988 Hz (16639 us/frame),
 *     with token-bucket frame skipping so a slow display can never slow the
 *     emulated console down,
 *   - no audio at all (the board has no speaker/DAC); the APU frame IRQ is
 *     still generated by nes.c's per-scanline fiq check, only the audio sample
 *     generation callback is never installed.
 *
 * GPLv2, as it is a derived work of nofrendo (c) 1998-2000 Matthew Conte.
 */

#include <stdio.h>
#include <string.h>
#include <stdint.h>
#include <stdbool.h>
#include <stddef.h>

#include "esp_err.h"
#include "esp_log.h"
#include "esp_timer.h"
#include "esp_heap_caps.h"
#include "freertos/FreeRTOS.h"
#include "freertos/task.h"

#include "nes_port.h"

/* nofrendo core headers last: they define their own integer types and macros */
#include <noftypes.h>
#include <nofconfig.h>
#include <log.h>
#include <osd.h>
#include <event.h>
#include <gui.h>
#include <vid_drv.h>
#include <nes.h>
#include <nes_ppu.h>
#include <nes_rom.h>
#include <nes_mmc.h>
#include <nes_pal.h>
#include <nesinput.h>

static const char *TAG = "nes";

/* ------------------------------------------------------------------------- */
/* Configuration                                                             */
/* ------------------------------------------------------------------------- */

#define NES_FB_W 256
#define NES_FB_H 240 /* the PPU really renders 240 scanlines */
#define NES_VIS_Y 8  /* standard NTSC top/bottom overscan crop -> 224 lines */
#define NES_VIS_H 224

/* NTSC NES: 60.0988 Hz -> 16639.35 us.  Accumulate 1 us every third frame. */
#define FRAME_PERIOD_US 16639

#define NES_PALETTE_SIZE 256
#define ROM_NAME_MAX 48
#define ASCII_COLS 80
#define ASCII_ROWS 25

#define ASCII_RAMP " .:-=+*#%@"
#define ASCII_RAMP_LEN 10
#define ASCII_BUF_SIZE (ASCII_ROWS * (ASCII_COLS + 1) + 1)

/* ------------------------------------------------------------------------- */
/* Static state (framebuffer lives in .bss, frame loop allocates nothing)    */
/* ------------------------------------------------------------------------- */

/* The PPU renders into this.  Rows 8..231 are the visible 224 line picture. */
static uint8_t s_fb[NES_FB_W * NES_FB_H] __attribute__((aligned(4)));

static uint16_t s_palette[NES_PALETTE_SIZE];
static uint8_t s_lum[NES_PALETTE_SIZE]; /* palette luminance, for ASCII dump */

static const uint8_t *s_rom;
static size_t s_rom_len;
static char s_rom_name[ROM_NAME_MAX] = "rom";
static uint32_t s_rom_mapper = 0xFFFFFFFFu;

static nes_frame_sink_t s_sink;
static nes_input_source_t s_input_src;

static volatile bool s_quit_request;
static volatile bool s_paused;
static bool s_initialized;
static bool s_running;
static bool s_debug_log;

static nes_t *s_nes;

/* Statistics */
static uint32_t s_frames;
static uint32_t s_drawn;
static uint32_t s_skipped;
static uint32_t s_fps_x100;
static uint32_t s_last_frame_us;
static uint32_t s_last_core_us;
static uint32_t s_last_sink_us;
static uint32_t s_max_frame_us;
static uint32_t s_total_frame_us;
static uint32_t s_total_core_us;
static uint32_t s_total_sink_us;
static uint32_t s_frame_sink_us; /* accumulated inside custom_blit */
static uint32_t s_heap_free;

static int64_t s_win_start;
static uint32_t s_win_frames;

/* ------------------------------------------------------------------------- */
/* Small helpers                                                             */
/* ------------------------------------------------------------------------- */

static void stats_reset(void)
{
    s_frames = s_drawn = s_skipped = 0;
    s_fps_x100 = 0;
    s_last_frame_us = s_last_core_us = s_last_sink_us = 0;
    s_max_frame_us = s_total_frame_us = s_total_core_us = s_total_sink_us = 0;
    s_win_frames = 0;
    s_win_start = esp_timer_get_time();
}

static void palette_refresh_luminance(void)
{
    for (int i = 0; i < NES_PALETTE_SIZE; i++) {
        uint16_t c = s_palette[i];
        int r = (c >> 11) & 0x1F;
        int g = (c >> 5) & 0x3F;
        int b = c & 0x1F;
        /* 0..255, cheap approximation of perceptual luminance */
        int l = (r * 8 * 299 + g * 4 * 587 + b * 8 * 114) / 1000;
        if (l > 255) l = 255;
        if (l < 0) l = 0;
        s_lum[i] = (uint8_t) l;
    }
}

/* The visible picture: skip the 8 line top overscan. */
static inline const uint8_t *fb_visible(void)
{
    return s_fb + (NES_VIS_Y * NES_FB_W);
}

/* ------------------------------------------------------------------------- */
/* Frame sink: what the platform layer gets to display                        */
/* ------------------------------------------------------------------------- */

/* Called through the video driver's custom_blit hook from vid_flush() at the
 * end of every rendered frame.  The PPU already wrote into s_fb. */
static void osd_custom_blit(bitmap_t *primary, int num_dirties, rect_t *dirty_rects)
{
    (void) num_dirties;
    (void) dirty_rects;

    int64_t t0 = esp_timer_get_time();

    if (s_sink != NULL) {
        const uint8_t *vis = primary->data + (NES_VIS_Y * primary->pitch);
        s_sink(vis, s_palette);
    }

    s_frame_sink_us = (uint32_t) (esp_timer_get_time() - t0);
}

/* ------------------------------------------------------------------------- */
/* Video driver (all the rendering is done by the nofrendo PPU)              */
/* ------------------------------------------------------------------------- */

static int video_init(int width, int height)
{
    (void) width;
    (void) height;
    return 0;
}

static void video_shutdown(void)
{
}

static int video_set_mode(int width, int height)
{
    (void) width;
    (void) height;
    return 0;
}

/* RGB565 conversion of the nofrendo 256 entry RGB palette. */
static void video_set_palette(rgb_t *pal)
{
    if (pal == NULL) {
        return;
    }

    for (int i = 0; i < NES_PALETTE_SIZE; i++) {
        uint16_t r = (uint16_t) (pal[i].r & 0xF8);
        uint16_t g = (uint16_t) (pal[i].g & 0xFC);
        uint16_t b = (uint16_t) (pal[i].b & 0xF8);
        s_palette[i] = (uint16_t) ((r << 8) | (g << 3) | (b >> 3));
    }

    palette_refresh_luminance();
}

static void video_clear(uint8_t color)
{
    memset(s_fb, color, sizeof(s_fb));
}

static bitmap_t *video_lock_write(void)
{
    return vid_getstaticbuffer();
}

static void video_free_write(int num_dirties, rect_t *dirty_rects)
{
    (void) num_dirties;
    (void) dirty_rects;
}

static viddriver_t s_driver = {
    .name = "MiniMario ESP32-C6 static framebuffer",
    .init = video_init,
    .shutdown = video_shutdown,
    .set_mode = video_set_mode,
    .set_palette = video_set_palette,
    .clear = video_clear,
    .lock_write = video_lock_write,
    .free_write = video_free_write,
    .custom_blit = osd_custom_blit,
    .invalidate = false,
};

/* ------------------------------------------------------------------------- */
/* nofrendo OSD / platform hooks                                             */
/* ------------------------------------------------------------------------- */

void osd_getvideoinfo(vidinfo_t *info)
{
    info->default_width = NES_FB_W;
    info->default_height = NES_FB_H;
    info->driver = &s_driver;
}

void osd_getsoundinfo(sndinfo_t *info)
{
    /* No audio hardware on this board.  The APU is still used for its frame
     * counter / frame IRQ logic, but we never install a sample callback. */
    info->sample_rate = 44100;
    info->bps = 16;
}

void osd_setsound(void (*playfunc)(void *buffer, int size))
{
    (void) playfunc; /* never called: we do not run nes_emulate() */
}

int osd_init(void)
{
    return 0;
}

void osd_shutdown(void)
{
}

/* Not used: the platform layer runs its own frame loop instead of
 * nofrendo's main_loop()/nes_emulate() timer driven loop. */
int osd_main(int argc, char *argv[])
{
    (void) argc;
    (void) argv;
    return -1;
}

int osd_installtimer(int frequency, void *func, int funcsize, void *counter,
                     int countersize)
{
    (void) frequency;
    (void) func;
    (void) funcsize;
    (void) counter;
    (void) countersize;
    return 0;
}

void osd_fullname(char *fullname, const char *shortname)
{
    strncpy(fullname, shortname, PATH_MAX - 1);
    fullname[PATH_MAX - 1] = '\0';
}

char *osd_newextension(char *string, char *ext)
{
    (void) ext;
    return string;
}

int osd_makesnapname(char *filename, int len)
{
    (void) filename;
    (void) len;
    return -1;
}

void osd_getmouse(int *x, int *y, int *button)
{
    if (x) *x = 0;
    if (y) *y = 0;
    if (button) *button = 0;
}

/* ROM image is supplied by the application through nes_port_set_rom(). */
char *osd_getromdata(void)
{
    return (char *) s_rom;
}

/* Joypad: call the app's input source once per emulated frame and turn the
 * NES_PAD_* mask into nofrendo joypad events. */
void osd_getinput(void)
{
    static const int event_map[8] = {
        event_joypad1_a,     event_joypad1_b,    event_joypad1_select,
        event_joypad1_start, event_joypad1_up,   event_joypad1_down,
        event_joypad1_left,  event_joypad1_right,
    };
    static uint8_t prev_buttons = 0;

    uint8_t buttons = (s_input_src != NULL) ? s_input_src() : 0;
    uint8_t changed = (uint8_t) (buttons ^ prev_buttons);
    prev_buttons = buttons;

    for (int bit = 0; bit < 8; bit++) {
        if ((changed & (1u << bit)) == 0) {
            continue;
        }
        event_t handler = event_get(event_map[bit]);
        if (handler != NULL) {
            handler((buttons & (1u << bit)) ? INP_STATE_MAKE : INP_STATE_BREAK);
        }
    }
}

/* ------------------------------------------------------------------------- */
/* Logging helpers                                                           */
/* ------------------------------------------------------------------------- */

uint32_t nes_port_fb_checksum(void)
{
    const uint8_t *p = fb_visible();
    uint32_t hash = 2166136261u;
    for (int i = 0; i < NES_VIS_H * NES_FB_W; i++) {
        hash ^= p[i];
        hash *= 16777619u;
    }
    return hash;
}

void nes_port_get_stats_ex(nes_port_stats_t *out)
{
    if (out == NULL) {
        return;
    }
    out->frames = s_frames;
    out->displayed = s_drawn;
    out->skipped = s_skipped;
    out->fps_x100 = s_fps_x100;
    out->last_frame_us = s_last_frame_us;
    out->last_core_us = s_last_core_us;
    out->last_sink_us = s_last_sink_us;
    out->max_frame_us = s_max_frame_us;
    out->total_frame_us = s_total_frame_us;
    out->total_core_us = s_total_core_us;
    out->total_sink_us = s_total_sink_us;
    out->mapper = (s_nes != NULL && s_nes->rominfo != NULL)
                      ? (uint32_t) s_nes->rominfo->mapper_number
                      : s_rom_mapper;
    out->heap_free = s_heap_free;
}

void nes_port_get_stats(uint32_t *frames, uint32_t *fps_x100,
                        uint32_t *last_frame_us, uint32_t *machine_name)
{
    if (frames) *frames = s_frames;
    if (fps_x100) *fps_x100 = s_fps_x100;
    if (last_frame_us) *last_frame_us = s_last_frame_us;
    if (machine_name) *machine_name = s_rom_mapper;
}

const uint8_t *nes_port_framebuffer(void)
{
    return fb_visible();
}

const uint16_t *nes_port_palette(void)
{
    return s_palette;
}

const char *nes_port_rom_name(void)
{
    return s_rom_name;
}

void nes_port_set_rom_name(const char *name)
{
    if (name == NULL || name[0] == '\0') {
        strncpy(s_rom_name, "rom", sizeof(s_rom_name) - 1);
    } else {
        strncpy(s_rom_name, name, sizeof(s_rom_name) - 1);
    }
    s_rom_name[sizeof(s_rom_name) - 1] = '\0';
}

void nes_port_set_debug_log(bool on)
{
    s_debug_log = on;
}

static void debug_log_frame(int64_t now)
{
    uint32_t chk = nes_port_fb_checksum();
    ESP_LOGI(TAG, "fps=%u.%02u frames=%u drawn=%u skipped=%u "
             "frame=%uus core=%uus sink=%uus heap=%u chk=%08x",
           (unsigned) (s_fps_x100 / 100), (unsigned) (s_fps_x100 % 100),
           (unsigned) s_frames, (unsigned) s_drawn, (unsigned) s_skipped,
           (unsigned) s_last_frame_us, (unsigned) s_last_core_us,
           (unsigned) s_last_sink_us, (unsigned) s_heap_free, (unsigned) chk);
    (void) now;
}

/* 80x25 ASCII art of the visible framebuffer, for eyeballing over serial. */
int nes_port_debug_ascii(char *out, size_t len)
{
    const uint8_t *fb = fb_visible();
    char line[ASCII_COLS + 1];
    int pos = 0;

    for (int row = 0; row < ASCII_ROWS; row++) {
        int y0 = row * NES_VIS_H / ASCII_ROWS;
        int y1 = (row + 1) * NES_VIS_H / ASCII_ROWS;
        if (y1 <= y0) y1 = y0 + 1;

        for (int col = 0; col < ASCII_COLS; col++) {
            int x0 = col * NES_FB_W / ASCII_COLS;
            int x1 = (col + 1) * NES_FB_W / ASCII_COLS;
            if (x1 <= x0) x1 = x0 + 1;

            uint32_t sum = 0;
            uint32_t count = 0;
            for (int y = y0; y < y1; y++) {
                const uint8_t *p = fb + y * NES_FB_W;
                for (int x = x0; x < x1; x++) {
                    sum += s_lum[p[x]];
                    count++;
                }
            }
            int lum = count ? (int) (sum / count) : 0;
            int idx = (lum * ASCII_RAMP_LEN) / 256;
            if (idx >= ASCII_RAMP_LEN) idx = ASCII_RAMP_LEN - 1;
            line[col] = ASCII_RAMP[idx];
        }
        line[ASCII_COLS] = '\0';

        if (out != NULL && pos + ASCII_COLS + 1 < (int) len) {
            memcpy(out + pos, line, ASCII_COLS);
        }
        pos += ASCII_COLS;
        if (out != NULL && pos + 1 < (int) len) {
            out[pos] = '\n';
        }
        pos += 1;
    }

    if (out != NULL && (size_t) pos < len) {
        out[pos] = '\0';
    }
    return pos;
}

/* ------------------------------------------------------------------------- */
/* Public API                                                                */
/* ------------------------------------------------------------------------- */

esp_err_t nes_port_init(void)
{
    if (s_initialized) {
        return ESP_OK;
    }

    /* Rendering target: static .bss buffer, handed to the video layer. */
    vid_setstaticbuffer(s_fb, NES_FB_W, NES_FB_H);

    if (vid_init(NES_FB_W, NES_FB_H, &s_driver) != 0) {
        return ESP_FAIL;
    }

    event_init();
    event_set_system(system_nes); /* joypad events -> nesinput */
    gui_init();

    palette_refresh_luminance();
    stats_reset();
    s_initialized = true;
    return ESP_OK;
}

esp_err_t nes_port_set_rom(const uint8_t *rom, size_t len)
{
    if (rom == NULL) {
        return ESP_ERR_INVALID_ARG;
    }
    if (s_running) {
        return ESP_ERR_INVALID_STATE;
    }
    if (len < 16 || memcmp(rom, "NES\x1a", 4) != 0) {
        ESP_LOGW(TAG, "not an iNES image");
        return ESP_ERR_INVALID_ARG;
    }

    uint8_t prg_banks = rom[4];
    uint8_t chr_banks = rom[5];
    uint8_t flags6 = rom[6];
    uint8_t flags7 = rom[7];
    uint32_t mapper = (uint32_t) ((flags6 >> 4) | (flags7 & 0xF0));

    size_t needed = 16;
    if (flags6 & 0x04) {
        needed += 512; /* trainer */
    }
    needed += (size_t) prg_banks * 16384u + (size_t) chr_banks * 8192u;
    if (len < needed) {
        ESP_LOGW(TAG, "truncated ROM: have %u need %u", (unsigned) len,
                 (unsigned) needed);
        return ESP_ERR_INVALID_SIZE;
    }
    if (!mmc_peek((int) mapper)) {
        ESP_LOGW(TAG, "mapper %u not supported", (unsigned) mapper);
        return ESP_ERR_NOT_SUPPORTED;
    }

    s_rom = rom;
    s_rom_len = len;
    s_rom_mapper = mapper;
    return ESP_OK;
}

const uint8_t *nes_port_get_rom(size_t *len)
{
    if (len != NULL) {
        *len = s_rom_len;
    }
    return s_rom;
}

void nes_port_set_frame_sink(nes_frame_sink_t sink)
{
    s_sink = sink;
}

void nes_port_set_input_source(nes_input_source_t src)
{
    s_input_src = src;
}

void nes_port_request_quit(void)
{
    s_quit_request = true;
}

bool nes_port_is_running(void)
{
    return s_running;
}

void nes_port_set_paused(bool paused)
{
    s_paused = paused;
}

bool nes_port_is_paused(void)
{
    return s_paused;
}

esp_err_t nes_port_run(void)
{
    if (!s_initialized) {
        ESP_LOGE(TAG, "nes_port_init() not called");
        return ESP_ERR_INVALID_STATE;
    }
    if (s_rom == NULL) {
        ESP_LOGE(TAG, "no ROM set");
        return ESP_ERR_INVALID_STATE;
    }
    if (s_running) {
        return ESP_ERR_INVALID_STATE;
    }

    int64_t heap_before = esp_get_free_heap_size();
    ESP_LOGI(TAG, "run: rom=%s len=%u mapper=%u heap_before=%d",
             s_rom_name, (unsigned) s_rom_len, (unsigned) s_rom_mapper,
             (int) heap_before);

    if (vid_setmode(NES_FB_W, NES_FB_H) != 0) {
        ESP_LOGE(TAG, "vid_setmode failed");
        return ESP_FAIL;
    }

    nes_t *nes = nes_create();
    if (nes == NULL) {
        ESP_LOGE(TAG, "nes_create failed");
        return ESP_FAIL;
    }
    s_nes = nes;

    int cart_err = nes_insertcart(s_rom_name, nes);
    if (cart_err != 0 || nes->rominfo == NULL) {
        ESP_LOGE(TAG, "nes_insertcart failed (%d)", cart_err);
        nes_poweroff();
        nes_destroy(&s_nes);
        s_nes = NULL;
        return ESP_FAIL;
    }

    s_rom_mapper = (uint32_t) nes->rominfo->mapper_number;
    s_heap_free = (uint32_t) esp_get_free_heap_size();
    ESP_LOGI(TAG, "cart ok: %s", rom_getinfo(nes->rominfo));
    ESP_LOGI(TAG, "heap_after_load=%u (used by emu=%d) prg=%dk chr=%dk mapper=%u",
             (unsigned) s_heap_free, (int) (heap_before - esp_get_free_heap_size()),
             (int) (nes->rominfo->rom_banks * 16),
             (int) (nes->rominfo->vrom_banks * 8),
             (unsigned) s_rom_mapper);

    /* ------------------------------------------------------------------ */
    /* Frame loop: exactly one emulated NTSC frame per 16639 us.           */
    /* ------------------------------------------------------------------ */
    stats_reset();
    s_quit_request = false;
    s_paused = false;
    s_running = true;

    bool draw = true;
    int64_t next_frame = esp_timer_get_time();
    int64_t deadline = next_frame;
    int32_t frac = 0;
    int64_t budget = FRAME_PERIOD_US; /* token bucket, decides frame skip */
    int64_t draw_extra = FRAME_PERIOD_US / 2;
    uint32_t last_draw_cost = 0;
    uint32_t last_skip_cost = 0;
    bool have_draw_cost = false;
    bool have_skip_cost = false;
    int64_t last_draw_time = next_frame;
    int64_t last_log_time = next_frame;

    while (!s_quit_request) {
        if (s_paused) {
            /* Keep the frame cadence (and quit responsiveness) but do not
             * advance the console, so the framebuffer stays stable. */
            deadline += FRAME_PERIOD_US;
            frac += 333;
            if (frac >= 1000) {
                frac -= 1000;
                deadline += 1;
            }
            int64_t tp = esp_timer_get_time();
            if (tp < deadline) {
                vTaskDelay((TickType_t) ((deadline - tp + 999) / 1000));
            } else if (tp - deadline > (int64_t) 4 * FRAME_PERIOD_US) {
                deadline = tp;
            }
            continue;
        }

        int64_t t0 = esp_timer_get_time();
        s_frame_sink_us = 0;

        if (draw) {
            nes_emulate_frame(true);
        } else {
            nes_emulate_frame(false);
        }

        int64_t t1 = esp_timer_get_time();
        uint32_t cost = (uint32_t) (t1 - t0);

        s_frames++;
        s_win_frames++;
        s_last_frame_us = cost;
        s_last_sink_us = s_frame_sink_us;
        s_last_core_us = (cost > s_frame_sink_us) ? cost - s_frame_sink_us : 0;
        s_total_frame_us += cost;
        s_total_core_us += s_last_core_us;
        s_total_sink_us += s_last_sink_us;
        if (cost > s_max_frame_us) {
            s_max_frame_us = cost;
        }

        if (draw) {
            s_drawn++;
            last_draw_cost = cost;
            have_draw_cost = true;
            last_draw_time = t1;
        } else {
            s_skipped++;
            last_skip_cost = cost;
            have_skip_cost = true;
        }

        /* Rolling fps over a ~2 s window (emulated frames, not displayed). */
        if (t1 - s_win_start >= 2000000) {
            int64_t span = t1 - s_win_start;
            if (span > 0) {
                s_fps_x100 = (uint32_t) (((int64_t) s_win_frames * 100000000) / span);
            }
            s_win_start = t1;
            s_win_frames = 0;
        }

        if (s_debug_log && (t1 - last_log_time) >= 1000000) {
            last_log_time = t1;
            s_heap_free = (uint32_t) esp_get_free_heap_size();
            debug_log_frame(t1);
        }

        /* Token bucket: every frame earns 16.6ms of emulated time, a drawn
         * frame costs an extra "render" amount compared to a skipped one.
         * When the display is slow this naturally produces a display rate
         * below 60Hz without ever slowing the emulated console down. */
        budget += (int64_t) FRAME_PERIOD_US - (int64_t) cost;
        if (budget > (int64_t) 3 * FRAME_PERIOD_US) {
            budget = (int64_t) 3 * FRAME_PERIOD_US;
        } else if (budget < (int64_t) -2 * FRAME_PERIOD_US) {
            budget = (int64_t) -2 * FRAME_PERIOD_US;
        }

        if (have_draw_cost && have_skip_cost) {
            draw_extra = (last_draw_cost > last_skip_cost)
                             ? (int64_t) (last_draw_cost - last_skip_cost)
                             : 0;
        }

        draw = (budget >= draw_extra - 500);
        if (!draw && (t1 - last_draw_time) > 500000) {
            draw = true; /* keep at least a couple of visible frames per second */
        }

        /* Absolute deadline pacing. */
        next_frame = deadline + FRAME_PERIOD_US;
        frac += 333;
        if (frac >= 1000) {
            frac -= 1000;
            next_frame += 1;
        }
        deadline = next_frame;

        int64_t t2 = esp_timer_get_time();
        if (t2 < deadline) {
            int64_t sleep_us = deadline - t2;
            /* Sleep in whole freeRTOS ticks; oversleeping less than one tick
             * does not accumulate because the deadline is absolute. */
            vTaskDelay((TickType_t) ((sleep_us + 999) / 1000));
        } else if (t2 - deadline > (int64_t) 4 * FRAME_PERIOD_US) {
            /* Far behind (e.g. display stall): resync, do not spin. */
            deadline = t2;
        }
    }

    /* ------------------------------------------------------------------ */
    /* Clean shutdown so another ROM can be loaded in the same boot.       */
    /* ------------------------------------------------------------------ */
    s_running = false;
    uint32_t frames = s_frames;
    uint32_t drawn = s_drawn;
    uint32_t skipped = s_skipped;
    uint32_t fps = s_fps_x100;
    uint32_t chk = nes_port_fb_checksum();

    nes_poweroff();
    nes_destroy(&s_nes);
    s_nes = NULL;
    s_heap_free = (uint32_t) esp_get_free_heap_size();

    ESP_LOGI(TAG, "run end: frames=%u drawn=%u skipped=%u fps=%u.%02u "
             "heap=%u chk=%08x",
             (unsigned) frames, (unsigned) drawn, (unsigned) skipped,
             (unsigned) (fps / 100), (unsigned) (fps % 100),
             (unsigned) s_heap_free, (unsigned) chk);

    return ESP_OK;
}
